/*******************************************************************************
* File Name: cyfittergnu.inc
* 
* PSoC Creator  4.2
*
* Description:
* 
* This file is automatically generated by PSoC Creator.
*
********************************************************************************
* Copyright (c) 2007-2018 Cypress Semiconductor.  All rights reserved.
* You may use this file only in accordance with the license, terms, conditions, 
* disclaimers, and limitations in the end user license agreement accompanying 
* the software package with which this file was provided.
********************************************************************************/

.ifndef INCLUDED_CYFITTERGNU_INC
.set INCLUDED_CYFITTERGNU_INC, 1
.include "cydevicegnu.inc"
.include "cydevicegnu_trm.inc"

/* RX */
.set RX__0__INTTYPE, CYREG_PICU12_INTTYPE6
.set RX__0__MASK, 0x40
.set RX__0__PC, CYREG_PRT12_PC6
.set RX__0__PORT, 12
.set RX__0__SHIFT, 6
.set RX__AG, CYREG_PRT12_AG
.set RX__BIE, CYREG_PRT12_BIE
.set RX__BIT_MASK, CYREG_PRT12_BIT_MASK
.set RX__BYP, CYREG_PRT12_BYP
.set RX__DM0, CYREG_PRT12_DM0
.set RX__DM1, CYREG_PRT12_DM1
.set RX__DM2, CYREG_PRT12_DM2
.set RX__DR, CYREG_PRT12_DR
.set RX__INP_DIS, CYREG_PRT12_INP_DIS
.set RX__INTTYPE_BASE, CYDEV_PICU_INTTYPE_PICU12_BASE
.set RX__MASK, 0x40
.set RX__PORT, 12
.set RX__PRT, CYREG_PRT12_PRT
.set RX__PRTDSI__DBL_SYNC_IN, CYREG_PRT12_DBL_SYNC_IN
.set RX__PRTDSI__OE_SEL0, CYREG_PRT12_OE_SEL0
.set RX__PRTDSI__OE_SEL1, CYREG_PRT12_OE_SEL1
.set RX__PRTDSI__OUT_SEL0, CYREG_PRT12_OUT_SEL0
.set RX__PRTDSI__OUT_SEL1, CYREG_PRT12_OUT_SEL1
.set RX__PRTDSI__SYNC_OUT, CYREG_PRT12_SYNC_OUT
.set RX__PS, CYREG_PRT12_PS
.set RX__SHIFT, 6
.set RX__SIO_CFG, CYREG_PRT12_SIO_CFG
.set RX__SIO_DIFF, CYREG_PRT12_SIO_DIFF
.set RX__SIO_HYST_EN, CYREG_PRT12_SIO_HYST_EN
.set RX__SIO_REG_HIFREQ, CYREG_PRT12_SIO_REG_HIFREQ
.set RX__SLW, CYREG_PRT12_SLW

/* TX */
.set TX__0__INTTYPE, CYREG_PICU12_INTTYPE7
.set TX__0__MASK, 0x80
.set TX__0__PC, CYREG_PRT12_PC7
.set TX__0__PORT, 12
.set TX__0__SHIFT, 7
.set TX__AG, CYREG_PRT12_AG
.set TX__BIE, CYREG_PRT12_BIE
.set TX__BIT_MASK, CYREG_PRT12_BIT_MASK
.set TX__BYP, CYREG_PRT12_BYP
.set TX__DM0, CYREG_PRT12_DM0
.set TX__DM1, CYREG_PRT12_DM1
.set TX__DM2, CYREG_PRT12_DM2
.set TX__DR, CYREG_PRT12_DR
.set TX__INP_DIS, CYREG_PRT12_INP_DIS
.set TX__INTTYPE_BASE, CYDEV_PICU_INTTYPE_PICU12_BASE
.set TX__MASK, 0x80
.set TX__PORT, 12
.set TX__PRT, CYREG_PRT12_PRT
.set TX__PRTDSI__DBL_SYNC_IN, CYREG_PRT12_DBL_SYNC_IN
.set TX__PRTDSI__OE_SEL0, CYREG_PRT12_OE_SEL0
.set TX__PRTDSI__OE_SEL1, CYREG_PRT12_OE_SEL1
.set TX__PRTDSI__OUT_SEL0, CYREG_PRT12_OUT_SEL0
.set TX__PRTDSI__OUT_SEL1, CYREG_PRT12_OUT_SEL1
.set TX__PRTDSI__SYNC_OUT, CYREG_PRT12_SYNC_OUT
.set TX__PS, CYREG_PRT12_PS
.set TX__SHIFT, 7
.set TX__SIO_CFG, CYREG_PRT12_SIO_CFG
.set TX__SIO_DIFF, CYREG_PRT12_SIO_DIFF
.set TX__SIO_HYST_EN, CYREG_PRT12_SIO_HYST_EN
.set TX__SIO_REG_HIFREQ, CYREG_PRT12_SIO_REG_HIFREQ
.set TX__SLW, CYREG_PRT12_SLW

/* BTN */
.set BTN__0__INTTYPE, CYREG_PICU0_INTTYPE1
.set BTN__0__MASK, 0x02
.set BTN__0__PC, CYREG_PRT0_PC1
.set BTN__0__PORT, 0
.set BTN__0__SHIFT, 1
.set BTN__AG, CYREG_PRT0_AG
.set BTN__AMUX, CYREG_PRT0_AMUX
.set BTN__BIE, CYREG_PRT0_BIE
.set BTN__BIT_MASK, CYREG_PRT0_BIT_MASK
.set BTN__BYP, CYREG_PRT0_BYP
.set BTN__CTL, CYREG_PRT0_CTL
.set BTN__DM0, CYREG_PRT0_DM0
.set BTN__DM1, CYREG_PRT0_DM1
.set BTN__DM2, CYREG_PRT0_DM2
.set BTN__DR, CYREG_PRT0_DR
.set BTN__INP_DIS, CYREG_PRT0_INP_DIS
.set BTN__INTSTAT, CYREG_PICU0_INTSTAT
.set BTN__INTTYPE_BASE, CYDEV_PICU_INTTYPE_PICU0_BASE
.set BTN__LCD_COM_SEG, CYREG_PRT0_LCD_COM_SEG
.set BTN__LCD_EN, CYREG_PRT0_LCD_EN
.set BTN__MASK, 0x02
.set BTN__PORT, 0
.set BTN__PRT, CYREG_PRT0_PRT
.set BTN__PRTDSI__CAPS_SEL, CYREG_PRT0_CAPS_SEL
.set BTN__PRTDSI__DBL_SYNC_IN, CYREG_PRT0_DBL_SYNC_IN
.set BTN__PRTDSI__OE_SEL0, CYREG_PRT0_OE_SEL0
.set BTN__PRTDSI__OE_SEL1, CYREG_PRT0_OE_SEL1
.set BTN__PRTDSI__OUT_SEL0, CYREG_PRT0_OUT_SEL0
.set BTN__PRTDSI__OUT_SEL1, CYREG_PRT0_OUT_SEL1
.set BTN__PRTDSI__SYNC_OUT, CYREG_PRT0_SYNC_OUT
.set BTN__PS, CYREG_PRT0_PS
.set BTN__SHIFT, 1
.set BTN__SLW, CYREG_PRT0_SLW
.set BTN__SNAP, CYREG_PICU0_SNAP

/* I2C */
.set I2C_I2C_FF__ADR, CYREG_I2C_ADR
.set I2C_I2C_FF__CFG, CYREG_I2C_CFG
.set I2C_I2C_FF__CLK_DIV1, CYREG_I2C_CLK_DIV1
.set I2C_I2C_FF__CLK_DIV2, CYREG_I2C_CLK_DIV2
.set I2C_I2C_FF__CSR, CYREG_I2C_CSR
.set I2C_I2C_FF__D, CYREG_I2C_D
.set I2C_I2C_FF__MCSR, CYREG_I2C_MCSR
.set I2C_I2C_FF__PM_ACT_CFG, CYREG_PM_ACT_CFG5
.set I2C_I2C_FF__PM_ACT_MSK, 0x04
.set I2C_I2C_FF__PM_STBY_CFG, CYREG_PM_STBY_CFG5
.set I2C_I2C_FF__PM_STBY_MSK, 0x04
.set I2C_I2C_FF__TMOUT_CFG0, CYREG_I2C_TMOUT_CFG0
.set I2C_I2C_FF__TMOUT_CFG1, CYREG_I2C_TMOUT_CFG1
.set I2C_I2C_FF__TMOUT_CSR, CYREG_I2C_TMOUT_CSR
.set I2C_I2C_FF__TMOUT_SR, CYREG_I2C_TMOUT_SR
.set I2C_I2C_FF__XCFG, CYREG_I2C_XCFG
.set I2C_I2C_IRQ__INTC_CLR_EN_REG, CYREG_NVIC_CLRENA0
.set I2C_I2C_IRQ__INTC_CLR_PD_REG, CYREG_NVIC_CLRPEND0
.set I2C_I2C_IRQ__INTC_MASK, 0x8000
.set I2C_I2C_IRQ__INTC_NUMBER, 15
.set I2C_I2C_IRQ__INTC_PRIOR_NUM, 7
.set I2C_I2C_IRQ__INTC_PRIOR_REG, CYREG_NVIC_PRI_15
.set I2C_I2C_IRQ__INTC_SET_EN_REG, CYREG_NVIC_SETENA0
.set I2C_I2C_IRQ__INTC_SET_PD_REG, CYREG_NVIC_SETPEND0

/* SCL */
.set SCL__0__INTTYPE, CYREG_PICU12_INTTYPE0
.set SCL__0__MASK, 0x01
.set SCL__0__PC, CYREG_PRT12_PC0
.set SCL__0__PORT, 12
.set SCL__0__SHIFT, 0
.set SCL__AG, CYREG_PRT12_AG
.set SCL__BIE, CYREG_PRT12_BIE
.set SCL__BIT_MASK, CYREG_PRT12_BIT_MASK
.set SCL__BYP, CYREG_PRT12_BYP
.set SCL__DM0, CYREG_PRT12_DM0
.set SCL__DM1, CYREG_PRT12_DM1
.set SCL__DM2, CYREG_PRT12_DM2
.set SCL__DR, CYREG_PRT12_DR
.set SCL__INP_DIS, CYREG_PRT12_INP_DIS
.set SCL__INTTYPE_BASE, CYDEV_PICU_INTTYPE_PICU12_BASE
.set SCL__MASK, 0x01
.set SCL__PORT, 12
.set SCL__PRT, CYREG_PRT12_PRT
.set SCL__PRTDSI__DBL_SYNC_IN, CYREG_PRT12_DBL_SYNC_IN
.set SCL__PRTDSI__OE_SEL0, CYREG_PRT12_OE_SEL0
.set SCL__PRTDSI__OE_SEL1, CYREG_PRT12_OE_SEL1
.set SCL__PRTDSI__OUT_SEL0, CYREG_PRT12_OUT_SEL0
.set SCL__PRTDSI__OUT_SEL1, CYREG_PRT12_OUT_SEL1
.set SCL__PRTDSI__SYNC_OUT, CYREG_PRT12_SYNC_OUT
.set SCL__PS, CYREG_PRT12_PS
.set SCL__SHIFT, 0
.set SCL__SIO_CFG, CYREG_PRT12_SIO_CFG
.set SCL__SIO_DIFF, CYREG_PRT12_SIO_DIFF
.set SCL__SIO_HYST_EN, CYREG_PRT12_SIO_HYST_EN
.set SCL__SIO_REG_HIFREQ, CYREG_PRT12_SIO_REG_HIFREQ
.set SCL__SLW, CYREG_PRT12_SLW

/* SDA */
.set SDA__0__INTTYPE, CYREG_PICU12_INTTYPE1
.set SDA__0__MASK, 0x02
.set SDA__0__PC, CYREG_PRT12_PC1
.set SDA__0__PORT, 12
.set SDA__0__SHIFT, 1
.set SDA__AG, CYREG_PRT12_AG
.set SDA__BIE, CYREG_PRT12_BIE
.set SDA__BIT_MASK, CYREG_PRT12_BIT_MASK
.set SDA__BYP, CYREG_PRT12_BYP
.set SDA__DM0, CYREG_PRT12_DM0
.set SDA__DM1, CYREG_PRT12_DM1
.set SDA__DM2, CYREG_PRT12_DM2
.set SDA__DR, CYREG_PRT12_DR
.set SDA__INP_DIS, CYREG_PRT12_INP_DIS
.set SDA__INTTYPE_BASE, CYDEV_PICU_INTTYPE_PICU12_BASE
.set SDA__MASK, 0x02
.set SDA__PORT, 12
.set SDA__PRT, CYREG_PRT12_PRT
.set SDA__PRTDSI__DBL_SYNC_IN, CYREG_PRT12_DBL_SYNC_IN
.set SDA__PRTDSI__OE_SEL0, CYREG_PRT12_OE_SEL0
.set SDA__PRTDSI__OE_SEL1, CYREG_PRT12_OE_SEL1
.set SDA__PRTDSI__OUT_SEL0, CYREG_PRT12_OUT_SEL0
.set SDA__PRTDSI__OUT_SEL1, CYREG_PRT12_OUT_SEL1
.set SDA__PRTDSI__SYNC_OUT, CYREG_PRT12_SYNC_OUT
.set SDA__PS, CYREG_PRT12_PS
.set SDA__SHIFT, 1
.set SDA__SIO_CFG, CYREG_PRT12_SIO_CFG
.set SDA__SIO_DIFF, CYREG_PRT12_SIO_DIFF
.set SDA__SIO_HYST_EN, CYREG_PRT12_SIO_HYST_EN
.set SDA__SIO_REG_HIFREQ, CYREG_PRT12_SIO_REG_HIFREQ
.set SDA__SLW, CYREG_PRT12_SLW

/* UART */
.set UART_BUART_sRX_RxBitCounter__16BIT_CONTROL_AUX_CTL_REG, CYREG_B1_UDB08_09_ACTL
.set UART_BUART_sRX_RxBitCounter__16BIT_CONTROL_CONTROL_REG, CYREG_B1_UDB08_09_CTL
.set UART_BUART_sRX_RxBitCounter__16BIT_CONTROL_COUNT_REG, CYREG_B1_UDB08_09_CTL
.set UART_BUART_sRX_RxBitCounter__16BIT_COUNT_CONTROL_REG, CYREG_B1_UDB08_09_CTL
.set UART_BUART_sRX_RxBitCounter__16BIT_COUNT_COUNT_REG, CYREG_B1_UDB08_09_CTL
.set UART_BUART_sRX_RxBitCounter__16BIT_MASK_MASK_REG, CYREG_B1_UDB08_09_MSK
.set UART_BUART_sRX_RxBitCounter__16BIT_MASK_PERIOD_REG, CYREG_B1_UDB08_09_MSK
.set UART_BUART_sRX_RxBitCounter__16BIT_PERIOD_MASK_REG, CYREG_B1_UDB08_09_MSK
.set UART_BUART_sRX_RxBitCounter__16BIT_PERIOD_PERIOD_REG, CYREG_B1_UDB08_09_MSK
.set UART_BUART_sRX_RxBitCounter__CONTROL_AUX_CTL_REG, CYREG_B1_UDB08_ACTL
.set UART_BUART_sRX_RxBitCounter__CONTROL_REG, CYREG_B1_UDB08_CTL
.set UART_BUART_sRX_RxBitCounter__CONTROL_ST_REG, CYREG_B1_UDB08_ST_CTL
.set UART_BUART_sRX_RxBitCounter__COUNT_REG, CYREG_B1_UDB08_CTL
.set UART_BUART_sRX_RxBitCounter__COUNT_ST_REG, CYREG_B1_UDB08_ST_CTL
.set UART_BUART_sRX_RxBitCounter__MASK_CTL_AUX_CTL_REG, CYREG_B1_UDB08_MSK_ACTL
.set UART_BUART_sRX_RxBitCounter__PER_CTL_AUX_CTL_REG, CYREG_B1_UDB08_MSK_ACTL
.set UART_BUART_sRX_RxBitCounter__PERIOD_REG, CYREG_B1_UDB08_MSK
.set UART_BUART_sRX_RxBitCounter_ST__16BIT_STATUS_AUX_CTL_REG, CYREG_B1_UDB08_09_ACTL
.set UART_BUART_sRX_RxBitCounter_ST__16BIT_STATUS_REG, CYREG_B1_UDB08_09_ST
.set UART_BUART_sRX_RxBitCounter_ST__MASK_REG, CYREG_B1_UDB08_MSK
.set UART_BUART_sRX_RxBitCounter_ST__MASK_ST_AUX_CTL_REG, CYREG_B1_UDB08_MSK_ACTL
.set UART_BUART_sRX_RxBitCounter_ST__PER_ST_AUX_CTL_REG, CYREG_B1_UDB08_MSK_ACTL
.set UART_BUART_sRX_RxBitCounter_ST__STATUS_AUX_CTL_REG, CYREG_B1_UDB08_ACTL
.set UART_BUART_sRX_RxBitCounter_ST__STATUS_CNT_REG, CYREG_B1_UDB08_ST_CTL
.set UART_BUART_sRX_RxBitCounter_ST__STATUS_CONTROL_REG, CYREG_B1_UDB08_ST_CTL
.set UART_BUART_sRX_RxBitCounter_ST__STATUS_REG, CYREG_B1_UDB08_ST
.set UART_BUART_sRX_RxShifter_u0__16BIT_A0_REG, CYREG_B1_UDB08_09_A0
.set UART_BUART_sRX_RxShifter_u0__16BIT_A1_REG, CYREG_B1_UDB08_09_A1
.set UART_BUART_sRX_RxShifter_u0__16BIT_D0_REG, CYREG_B1_UDB08_09_D0
.set UART_BUART_sRX_RxShifter_u0__16BIT_D1_REG, CYREG_B1_UDB08_09_D1
.set UART_BUART_sRX_RxShifter_u0__16BIT_DP_AUX_CTL_REG, CYREG_B1_UDB08_09_ACTL
.set UART_BUART_sRX_RxShifter_u0__16BIT_F0_REG, CYREG_B1_UDB08_09_F0
.set UART_BUART_sRX_RxShifter_u0__16BIT_F1_REG, CYREG_B1_UDB08_09_F1
.set UART_BUART_sRX_RxShifter_u0__A0_A1_REG, CYREG_B1_UDB08_A0_A1
.set UART_BUART_sRX_RxShifter_u0__A0_REG, CYREG_B1_UDB08_A0
.set UART_BUART_sRX_RxShifter_u0__A1_REG, CYREG_B1_UDB08_A1
.set UART_BUART_sRX_RxShifter_u0__D0_D1_REG, CYREG_B1_UDB08_D0_D1
.set UART_BUART_sRX_RxShifter_u0__D0_REG, CYREG_B1_UDB08_D0
.set UART_BUART_sRX_RxShifter_u0__D1_REG, CYREG_B1_UDB08_D1
.set UART_BUART_sRX_RxShifter_u0__DP_AUX_CTL_REG, CYREG_B1_UDB08_ACTL
.set UART_BUART_sRX_RxShifter_u0__F0_F1_REG, CYREG_B1_UDB08_F0_F1
.set UART_BUART_sRX_RxShifter_u0__F0_REG, CYREG_B1_UDB08_F0
.set UART_BUART_sRX_RxShifter_u0__F1_REG, CYREG_B1_UDB08_F1
.set UART_BUART_sRX_RxShifter_u0__MSK_DP_AUX_CTL_REG, CYREG_B1_UDB08_MSK_ACTL
.set UART_BUART_sRX_RxShifter_u0__PER_DP_AUX_CTL_REG, CYREG_B1_UDB08_MSK_ACTL
.set UART_BUART_sRX_RxSts__3__MASK, 0x08
.set UART_BUART_sRX_RxSts__3__POS, 3
.set UART_BUART_sRX_RxSts__4__MASK, 0x10
.set UART_BUART_sRX_RxSts__4__POS, 4
.set UART_BUART_sRX_RxSts__5__MASK, 0x20
.set UART_BUART_sRX_RxSts__5__POS, 5
.set UART_BUART_sRX_RxSts__MASK, 0x38
.set UART_BUART_sRX_RxSts__MASK_REG, CYREG_B1_UDB11_MSK
.set UART_BUART_sRX_RxSts__STATUS_AUX_CTL_REG, CYREG_B1_UDB11_ACTL
.set UART_BUART_sRX_RxSts__STATUS_REG, CYREG_B1_UDB11_ST
.set UART_BUART_sTX_sCLOCK_TxBitClkGen__16BIT_A0_REG, CYREG_B0_UDB09_10_A0
.set UART_BUART_sTX_sCLOCK_TxBitClkGen__16BIT_A1_REG, CYREG_B0_UDB09_10_A1
.set UART_BUART_sTX_sCLOCK_TxBitClkGen__16BIT_D0_REG, CYREG_B0_UDB09_10_D0
.set UART_BUART_sTX_sCLOCK_TxBitClkGen__16BIT_D1_REG, CYREG_B0_UDB09_10_D1
.set UART_BUART_sTX_sCLOCK_TxBitClkGen__16BIT_DP_AUX_CTL_REG, CYREG_B0_UDB09_10_ACTL
.set UART_BUART_sTX_sCLOCK_TxBitClkGen__16BIT_F0_REG, CYREG_B0_UDB09_10_F0
.set UART_BUART_sTX_sCLOCK_TxBitClkGen__16BIT_F1_REG, CYREG_B0_UDB09_10_F1
.set UART_BUART_sTX_sCLOCK_TxBitClkGen__A0_A1_REG, CYREG_B0_UDB09_A0_A1
.set UART_BUART_sTX_sCLOCK_TxBitClkGen__A0_REG, CYREG_B0_UDB09_A0
.set UART_BUART_sTX_sCLOCK_TxBitClkGen__A1_REG, CYREG_B0_UDB09_A1
.set UART_BUART_sTX_sCLOCK_TxBitClkGen__D0_D1_REG, CYREG_B0_UDB09_D0_D1
.set UART_BUART_sTX_sCLOCK_TxBitClkGen__D0_REG, CYREG_B0_UDB09_D0
.set UART_BUART_sTX_sCLOCK_TxBitClkGen__D1_REG, CYREG_B0_UDB09_D1
.set UART_BUART_sTX_sCLOCK_TxBitClkGen__DP_AUX_CTL_REG, CYREG_B0_UDB09_ACTL
.set UART_BUART_sTX_sCLOCK_TxBitClkGen__F0_F1_REG, CYREG_B0_UDB09_F0_F1
.set UART_BUART_sTX_sCLOCK_TxBitClkGen__F0_REG, CYREG_B0_UDB09_F0
.set UART_BUART_sTX_sCLOCK_TxBitClkGen__F1_REG, CYREG_B0_UDB09_F1
.set UART_BUART_sTX_TxShifter_u0__16BIT_A0_REG, CYREG_B0_UDB08_09_A0
.set UART_BUART_sTX_TxShifter_u0__16BIT_A1_REG, CYREG_B0_UDB08_09_A1
.set UART_BUART_sTX_TxShifter_u0__16BIT_D0_REG, CYREG_B0_UDB08_09_D0
.set UART_BUART_sTX_TxShifter_u0__16BIT_D1_REG, CYREG_B0_UDB08_09_D1
.set UART_BUART_sTX_TxShifter_u0__16BIT_DP_AUX_CTL_REG, CYREG_B0_UDB08_09_ACTL
.set UART_BUART_sTX_TxShifter_u0__16BIT_F0_REG, CYREG_B0_UDB08_09_F0
.set UART_BUART_sTX_TxShifter_u0__16BIT_F1_REG, CYREG_B0_UDB08_09_F1
.set UART_BUART_sTX_TxShifter_u0__A0_A1_REG, CYREG_B0_UDB08_A0_A1
.set UART_BUART_sTX_TxShifter_u0__A0_REG, CYREG_B0_UDB08_A0
.set UART_BUART_sTX_TxShifter_u0__A1_REG, CYREG_B0_UDB08_A1
.set UART_BUART_sTX_TxShifter_u0__D0_D1_REG, CYREG_B0_UDB08_D0_D1
.set UART_BUART_sTX_TxShifter_u0__D0_REG, CYREG_B0_UDB08_D0
.set UART_BUART_sTX_TxShifter_u0__D1_REG, CYREG_B0_UDB08_D1
.set UART_BUART_sTX_TxShifter_u0__DP_AUX_CTL_REG, CYREG_B0_UDB08_ACTL
.set UART_BUART_sTX_TxShifter_u0__F0_F1_REG, CYREG_B0_UDB08_F0_F1
.set UART_BUART_sTX_TxShifter_u0__F0_REG, CYREG_B0_UDB08_F0
.set UART_BUART_sTX_TxShifter_u0__F1_REG, CYREG_B0_UDB08_F1
.set UART_BUART_sTX_TxSts__0__MASK, 0x01
.set UART_BUART_sTX_TxSts__0__POS, 0
.set UART_BUART_sTX_TxSts__1__MASK, 0x02
.set UART_BUART_sTX_TxSts__1__POS, 1
.set UART_BUART_sTX_TxSts__16BIT_STATUS_AUX_CTL_REG, CYREG_B0_UDB08_09_ACTL
.set UART_BUART_sTX_TxSts__16BIT_STATUS_REG, CYREG_B0_UDB08_09_ST
.set UART_BUART_sTX_TxSts__2__MASK, 0x04
.set UART_BUART_sTX_TxSts__2__POS, 2
.set UART_BUART_sTX_TxSts__3__MASK, 0x08
.set UART_BUART_sTX_TxSts__3__POS, 3
.set UART_BUART_sTX_TxSts__MASK, 0x0F
.set UART_BUART_sTX_TxSts__MASK_REG, CYREG_B0_UDB08_MSK
.set UART_BUART_sTX_TxSts__STATUS_AUX_CTL_REG, CYREG_B0_UDB08_ACTL
.set UART_BUART_sTX_TxSts__STATUS_REG, CYREG_B0_UDB08_ST
.set UART_IntClock__CFG0, CYREG_CLKDIST_DCFG0_CFG0
.set UART_IntClock__CFG1, CYREG_CLKDIST_DCFG0_CFG1
.set UART_IntClock__CFG2, CYREG_CLKDIST_DCFG0_CFG2
.set UART_IntClock__CFG2_SRC_SEL_MASK, 0x07
.set UART_IntClock__INDEX, 0x00
.set UART_IntClock__PM_ACT_CFG, CYREG_PM_ACT_CFG2
.set UART_IntClock__PM_ACT_MSK, 0x01
.set UART_IntClock__PM_STBY_CFG, CYREG_PM_STBY_CFG2
.set UART_IntClock__PM_STBY_MSK, 0x01

/* LED_0 */
.set LED_0__0__INTTYPE, CYREG_PICU0_INTTYPE2
.set LED_0__0__MASK, 0x04
.set LED_0__0__PC, CYREG_PRT0_PC2
.set LED_0__0__PORT, 0
.set LED_0__0__SHIFT, 2
.set LED_0__AG, CYREG_PRT0_AG
.set LED_0__AMUX, CYREG_PRT0_AMUX
.set LED_0__BIE, CYREG_PRT0_BIE
.set LED_0__BIT_MASK, CYREG_PRT0_BIT_MASK
.set LED_0__BYP, CYREG_PRT0_BYP
.set LED_0__CTL, CYREG_PRT0_CTL
.set LED_0__DM0, CYREG_PRT0_DM0
.set LED_0__DM1, CYREG_PRT0_DM1
.set LED_0__DM2, CYREG_PRT0_DM2
.set LED_0__DR, CYREG_PRT0_DR
.set LED_0__INP_DIS, CYREG_PRT0_INP_DIS
.set LED_0__INTTYPE_BASE, CYDEV_PICU_INTTYPE_PICU0_BASE
.set LED_0__LCD_COM_SEG, CYREG_PRT0_LCD_COM_SEG
.set LED_0__LCD_EN, CYREG_PRT0_LCD_EN
.set LED_0__MASK, 0x04
.set LED_0__PORT, 0
.set LED_0__PRT, CYREG_PRT0_PRT
.set LED_0__PRTDSI__CAPS_SEL, CYREG_PRT0_CAPS_SEL
.set LED_0__PRTDSI__DBL_SYNC_IN, CYREG_PRT0_DBL_SYNC_IN
.set LED_0__PRTDSI__OE_SEL0, CYREG_PRT0_OE_SEL0
.set LED_0__PRTDSI__OE_SEL1, CYREG_PRT0_OE_SEL1
.set LED_0__PRTDSI__OUT_SEL0, CYREG_PRT0_OUT_SEL0
.set LED_0__PRTDSI__OUT_SEL1, CYREG_PRT0_OUT_SEL1
.set LED_0__PRTDSI__SYNC_OUT, CYREG_PRT0_SYNC_OUT
.set LED_0__PS, CYREG_PRT0_PS
.set LED_0__SHIFT, 2
.set LED_0__SLW, CYREG_PRT0_SLW

/* LED_1 */
.set LED_1__0__INTTYPE, CYREG_PICU0_INTTYPE3
.set LED_1__0__MASK, 0x08
.set LED_1__0__PC, CYREG_PRT0_PC3
.set LED_1__0__PORT, 0
.set LED_1__0__SHIFT, 3
.set LED_1__AG, CYREG_PRT0_AG
.set LED_1__AMUX, CYREG_PRT0_AMUX
.set LED_1__BIE, CYREG_PRT0_BIE
.set LED_1__BIT_MASK, CYREG_PRT0_BIT_MASK
.set LED_1__BYP, CYREG_PRT0_BYP
.set LED_1__CTL, CYREG_PRT0_CTL
.set LED_1__DM0, CYREG_PRT0_DM0
.set LED_1__DM1, CYREG_PRT0_DM1
.set LED_1__DM2, CYREG_PRT0_DM2
.set LED_1__DR, CYREG_PRT0_DR
.set LED_1__INP_DIS, CYREG_PRT0_INP_DIS
.set LED_1__INTTYPE_BASE, CYDEV_PICU_INTTYPE_PICU0_BASE
.set LED_1__LCD_COM_SEG, CYREG_PRT0_LCD_COM_SEG
.set LED_1__LCD_EN, CYREG_PRT0_LCD_EN
.set LED_1__MASK, 0x08
.set LED_1__PORT, 0
.set LED_1__PRT, CYREG_PRT0_PRT
.set LED_1__PRTDSI__CAPS_SEL, CYREG_PRT0_CAPS_SEL
.set LED_1__PRTDSI__DBL_SYNC_IN, CYREG_PRT0_DBL_SYNC_IN
.set LED_1__PRTDSI__OE_SEL0, CYREG_PRT0_OE_SEL0
.set LED_1__PRTDSI__OE_SEL1, CYREG_PRT0_OE_SEL1
.set LED_1__PRTDSI__OUT_SEL0, CYREG_PRT0_OUT_SEL0
.set LED_1__PRTDSI__OUT_SEL1, CYREG_PRT0_OUT_SEL1
.set LED_1__PRTDSI__SYNC_OUT, CYREG_PRT0_SYNC_OUT
.set LED_1__PS, CYREG_PRT0_PS
.set LED_1__SHIFT, 3
.set LED_1__SLW, CYREG_PRT0_SLW

/* ListC */
.set ListC__0__INTTYPE, CYREG_PICU0_INTTYPE0
.set ListC__0__MASK, 0x01
.set ListC__0__PC, CYREG_PRT0_PC0
.set ListC__0__PORT, 0
.set ListC__0__SHIFT, 0
.set ListC__AG, CYREG_PRT0_AG
.set ListC__AMUX, CYREG_PRT0_AMUX
.set ListC__BIE, CYREG_PRT0_BIE
.set ListC__BIT_MASK, CYREG_PRT0_BIT_MASK
.set ListC__BYP, CYREG_PRT0_BYP
.set ListC__CTL, CYREG_PRT0_CTL
.set ListC__DM0, CYREG_PRT0_DM0
.set ListC__DM1, CYREG_PRT0_DM1
.set ListC__DM2, CYREG_PRT0_DM2
.set ListC__DR, CYREG_PRT0_DR
.set ListC__INP_DIS, CYREG_PRT0_INP_DIS
.set ListC__INTTYPE_BASE, CYDEV_PICU_INTTYPE_PICU0_BASE
.set ListC__LCD_COM_SEG, CYREG_PRT0_LCD_COM_SEG
.set ListC__LCD_EN, CYREG_PRT0_LCD_EN
.set ListC__MASK, 0x01
.set ListC__PORT, 0
.set ListC__PRT, CYREG_PRT0_PRT
.set ListC__PRTDSI__CAPS_SEL, CYREG_PRT0_CAPS_SEL
.set ListC__PRTDSI__DBL_SYNC_IN, CYREG_PRT0_DBL_SYNC_IN
.set ListC__PRTDSI__OE_SEL0, CYREG_PRT0_OE_SEL0
.set ListC__PRTDSI__OE_SEL1, CYREG_PRT0_OE_SEL1
.set ListC__PRTDSI__OUT_SEL0, CYREG_PRT0_OUT_SEL0
.set ListC__PRTDSI__OUT_SEL1, CYREG_PRT0_OUT_SEL1
.set ListC__PRTDSI__SYNC_OUT, CYREG_PRT0_SYNC_OUT
.set ListC__PS, CYREG_PRT0_PS
.set ListC__SHIFT, 0
.set ListC__SLW, CYREG_PRT0_SLW

/* counting */
.set counting__INTC_CLR_EN_REG, CYREG_NVIC_CLRENA0
.set counting__INTC_CLR_PD_REG, CYREG_NVIC_CLRPEND0
.set counting__INTC_MASK, 0x10
.set counting__INTC_NUMBER, 4
.set counting__INTC_PRIOR_NUM, 7
.set counting__INTC_PRIOR_REG, CYREG_NVIC_PRI_4
.set counting__INTC_SET_EN_REG, CYREG_NVIC_SETENA0
.set counting__INTC_SET_PD_REG, CYREG_NVIC_SETPEND0

/* time_isr */
.set time_isr__INTC_CLR_EN_REG, CYREG_NVIC_CLRENA0
.set time_isr__INTC_CLR_PD_REG, CYREG_NVIC_CLRPEND0
.set time_isr__INTC_MASK, 0x20000
.set time_isr__INTC_NUMBER, 17
.set time_isr__INTC_PRIOR_NUM, 7
.set time_isr__INTC_PRIOR_REG, CYREG_NVIC_PRI_17
.set time_isr__INTC_SET_EN_REG, CYREG_NVIC_SETENA0
.set time_isr__INTC_SET_PD_REG, CYREG_NVIC_SETPEND0

/* timer_clock */
.set timer_clock__CFG0, CYREG_CLKDIST_DCFG1_CFG0
.set timer_clock__CFG1, CYREG_CLKDIST_DCFG1_CFG1
.set timer_clock__CFG2, CYREG_CLKDIST_DCFG1_CFG2
.set timer_clock__CFG2_SRC_SEL_MASK, 0x07
.set timer_clock__INDEX, 0x01
.set timer_clock__PM_ACT_CFG, CYREG_PM_ACT_CFG2
.set timer_clock__PM_ACT_MSK, 0x02
.set timer_clock__PM_STBY_CFG, CYREG_PM_STBY_CFG2
.set timer_clock__PM_STBY_MSK, 0x02

/* Timer_TimerHW */
.set Timer_TimerHW__CAP0, CYREG_TMR0_CAP0
.set Timer_TimerHW__CAP1, CYREG_TMR0_CAP1
.set Timer_TimerHW__CFG0, CYREG_TMR0_CFG0
.set Timer_TimerHW__CFG1, CYREG_TMR0_CFG1
.set Timer_TimerHW__CFG2, CYREG_TMR0_CFG2
.set Timer_TimerHW__CNT_CMP0, CYREG_TMR0_CNT_CMP0
.set Timer_TimerHW__CNT_CMP1, CYREG_TMR0_CNT_CMP1
.set Timer_TimerHW__PER0, CYREG_TMR0_PER0
.set Timer_TimerHW__PER1, CYREG_TMR0_PER1
.set Timer_TimerHW__PM_ACT_CFG, CYREG_PM_ACT_CFG3
.set Timer_TimerHW__PM_ACT_MSK, 0x01
.set Timer_TimerHW__PM_STBY_CFG, CYREG_PM_STBY_CFG3
.set Timer_TimerHW__PM_STBY_MSK, 0x01
.set Timer_TimerHW__RT0, CYREG_TMR0_RT0
.set Timer_TimerHW__RT1, CYREG_TMR0_RT1
.set Timer_TimerHW__SR0, CYREG_TMR0_SR0

/* Miscellaneous */
.set BCLK__BUS_CLK__HZ, 24000000
.set BCLK__BUS_CLK__KHZ, 24000
.set BCLK__BUS_CLK__MHZ, 24
.set CYDEV_CHIP_DIE_LEOPARD, 1
.set CYDEV_CHIP_DIE_PSOC4A, 18
.set CYDEV_CHIP_DIE_PSOC5LP, 2
.set CYDEV_CHIP_DIE_PSOC5TM, 3
.set CYDEV_CHIP_DIE_TMA4, 4
.set CYDEV_CHIP_DIE_UNKNOWN, 0
.set CYDEV_CHIP_FAMILY_FM0P, 5
.set CYDEV_CHIP_FAMILY_FM3, 6
.set CYDEV_CHIP_FAMILY_FM4, 7
.set CYDEV_CHIP_FAMILY_PSOC3, 1
.set CYDEV_CHIP_FAMILY_PSOC4, 2
.set CYDEV_CHIP_FAMILY_PSOC5, 3
.set CYDEV_CHIP_FAMILY_PSOC6, 4
.set CYDEV_CHIP_FAMILY_UNKNOWN, 0
.set CYDEV_CHIP_FAMILY_USED, CYDEV_CHIP_FAMILY_PSOC5
.set CYDEV_CHIP_JTAG_ID, 0x2E161069
.set CYDEV_CHIP_MEMBER_3A, 1
.set CYDEV_CHIP_MEMBER_4A, 18
.set CYDEV_CHIP_MEMBER_4D, 13
.set CYDEV_CHIP_MEMBER_4E, 6
.set CYDEV_CHIP_MEMBER_4F, 19
.set CYDEV_CHIP_MEMBER_4G, 4
.set CYDEV_CHIP_MEMBER_4H, 17
.set CYDEV_CHIP_MEMBER_4I, 23
.set CYDEV_CHIP_MEMBER_4J, 14
.set CYDEV_CHIP_MEMBER_4K, 15
.set CYDEV_CHIP_MEMBER_4L, 22
.set CYDEV_CHIP_MEMBER_4M, 21
.set CYDEV_CHIP_MEMBER_4N, 10
.set CYDEV_CHIP_MEMBER_4O, 7
.set CYDEV_CHIP_MEMBER_4P, 20
.set CYDEV_CHIP_MEMBER_4Q, 12
.set CYDEV_CHIP_MEMBER_4R, 8
.set CYDEV_CHIP_MEMBER_4S, 11
.set CYDEV_CHIP_MEMBER_4T, 9
.set CYDEV_CHIP_MEMBER_4U, 5
.set CYDEV_CHIP_MEMBER_4V, 16
.set CYDEV_CHIP_MEMBER_5A, 3
.set CYDEV_CHIP_MEMBER_5B, 2
.set CYDEV_CHIP_MEMBER_6A, 24
.set CYDEV_CHIP_MEMBER_FM3, 28
.set CYDEV_CHIP_MEMBER_FM4, 29
.set CYDEV_CHIP_MEMBER_PDL_FM0P_TYPE1, 25
.set CYDEV_CHIP_MEMBER_PDL_FM0P_TYPE2, 26
.set CYDEV_CHIP_MEMBER_PDL_FM0P_TYPE3, 27
.set CYDEV_CHIP_MEMBER_UNKNOWN, 0
.set CYDEV_CHIP_MEMBER_USED, CYDEV_CHIP_MEMBER_5B
.set CYDEV_CHIP_DIE_EXPECT, CYDEV_CHIP_MEMBER_USED
.set CYDEV_CHIP_DIE_ACTUAL, CYDEV_CHIP_DIE_EXPECT
.set CYDEV_CHIP_REV_LEOPARD_ES1, 0
.set CYDEV_CHIP_REV_LEOPARD_ES2, 1
.set CYDEV_CHIP_REV_LEOPARD_ES3, 3
.set CYDEV_CHIP_REV_LEOPARD_PRODUCTION, 3
.set CYDEV_CHIP_REV_PSOC4A_ES0, 17
.set CYDEV_CHIP_REV_PSOC4A_PRODUCTION, 17
.set CYDEV_CHIP_REV_PSOC5LP_ES0, 0
.set CYDEV_CHIP_REV_PSOC5LP_PRODUCTION, 0
.set CYDEV_CHIP_REV_PSOC5TM_ES0, 0
.set CYDEV_CHIP_REV_PSOC5TM_ES1, 1
.set CYDEV_CHIP_REV_PSOC5TM_PRODUCTION, 1
.set CYDEV_CHIP_REV_TMA4_ES, 17
.set CYDEV_CHIP_REV_TMA4_ES2, 33
.set CYDEV_CHIP_REV_TMA4_PRODUCTION, 17
.set CYDEV_CHIP_REVISION_3A_ES1, 0
.set CYDEV_CHIP_REVISION_3A_ES2, 1
.set CYDEV_CHIP_REVISION_3A_ES3, 3
.set CYDEV_CHIP_REVISION_3A_PRODUCTION, 3
.set CYDEV_CHIP_REVISION_4A_ES0, 17
.set CYDEV_CHIP_REVISION_4A_PRODUCTION, 17
.set CYDEV_CHIP_REVISION_4D_PRODUCTION, 0
.set CYDEV_CHIP_REVISION_4E_CCG2_NO_USBPD, 0
.set CYDEV_CHIP_REVISION_4E_PRODUCTION, 0
.set CYDEV_CHIP_REVISION_4F_PRODUCTION, 0
.set CYDEV_CHIP_REVISION_4F_PRODUCTION_256DMA, 0
.set CYDEV_CHIP_REVISION_4F_PRODUCTION_256K, 0
.set CYDEV_CHIP_REVISION_4G_ES, 17
.set CYDEV_CHIP_REVISION_4G_ES2, 33
.set CYDEV_CHIP_REVISION_4G_PRODUCTION, 17
.set CYDEV_CHIP_REVISION_4H_PRODUCTION, 0
.set CYDEV_CHIP_REVISION_4I_PRODUCTION, 0
.set CYDEV_CHIP_REVISION_4J_PRODUCTION, 0
.set CYDEV_CHIP_REVISION_4K_PRODUCTION, 0
.set CYDEV_CHIP_REVISION_4L_PRODUCTION, 0
.set CYDEV_CHIP_REVISION_4M_PRODUCTION, 0
.set CYDEV_CHIP_REVISION_4N_PRODUCTION, 0
.set CYDEV_CHIP_REVISION_4O_PRODUCTION, 0
.set CYDEV_CHIP_REVISION_4P_PRODUCTION, 0
.set CYDEV_CHIP_REVISION_4Q_PRODUCTION, 0
.set CYDEV_CHIP_REVISION_4R_PRODUCTION, 0
.set CYDEV_CHIP_REVISION_4S_PRODUCTION, 0
.set CYDEV_CHIP_REVISION_4T_PRODUCTION, 0
.set CYDEV_CHIP_REVISION_4U_PRODUCTION, 0
.set CYDEV_CHIP_REVISION_4V_PRODUCTION, 0
.set CYDEV_CHIP_REVISION_5A_ES0, 0
.set CYDEV_CHIP_REVISION_5A_ES1, 1
.set CYDEV_CHIP_REVISION_5A_PRODUCTION, 1
.set CYDEV_CHIP_REVISION_5B_ES0, 0
.set CYDEV_CHIP_REVISION_5B_PRODUCTION, 0
.set CYDEV_CHIP_REVISION_6A_ES, 17
.set CYDEV_CHIP_REVISION_6A_NO_UDB, 33
.set CYDEV_CHIP_REVISION_6A_PRODUCTION, 33
.set CYDEV_CHIP_REVISION_FM3_PRODUCTION, 0
.set CYDEV_CHIP_REVISION_FM4_PRODUCTION, 0
.set CYDEV_CHIP_REVISION_PDL_FM0P_TYPE1_PRODUCTION, 0
.set CYDEV_CHIP_REVISION_PDL_FM0P_TYPE2_PRODUCTION, 0
.set CYDEV_CHIP_REVISION_PDL_FM0P_TYPE3_PRODUCTION, 0
.set CYDEV_CHIP_REVISION_USED, CYDEV_CHIP_REVISION_5B_PRODUCTION
.set CYDEV_CHIP_REV_EXPECT, CYDEV_CHIP_REVISION_USED
.set CYDEV_CONFIG_FASTBOOT_ENABLED, 1
.set CYDEV_CONFIG_UNUSED_IO_AllowButWarn, 0
.set CYDEV_CONFIG_UNUSED_IO, CYDEV_CONFIG_UNUSED_IO_AllowButWarn
.set CYDEV_CONFIG_UNUSED_IO_AllowWithInfo, 1
.set CYDEV_CONFIG_UNUSED_IO_Disallowed, 2
.set CYDEV_CONFIGURATION_COMPRESSED, 1
.set CYDEV_CONFIGURATION_DMA, 0
.set CYDEV_CONFIGURATION_ECC, 1
.set CYDEV_CONFIGURATION_IMOENABLED, CYDEV_CONFIG_FASTBOOT_ENABLED
.set CYDEV_CONFIGURATION_MODE_COMPRESSED, 0
.set CYDEV_CONFIGURATION_MODE, CYDEV_CONFIGURATION_MODE_COMPRESSED
.set CYDEV_CONFIGURATION_MODE_DMA, 2
.set CYDEV_CONFIGURATION_MODE_UNCOMPRESSED, 1
.set CYDEV_DEBUG_ENABLE_MASK, 0x20
.set CYDEV_DEBUG_ENABLE_REGISTER, CYREG_MLOGIC_DEBUG
.set CYDEV_DEBUGGING_DPS_Disable, 3
.set CYDEV_DEBUGGING_DPS_JTAG_4, 1
.set CYDEV_DEBUGGING_DPS_JTAG_5, 0
.set CYDEV_DEBUGGING_DPS_SWD, 2
.set CYDEV_DEBUGGING_DPS_SWD_SWV, 6
.set CYDEV_DEBUGGING_DPS, CYDEV_DEBUGGING_DPS_SWD_SWV
.set CYDEV_DEBUGGING_ENABLE, 1
.set CYDEV_DEBUGGING_XRES, 0
.set CYDEV_DMA_CHANNELS_AVAILABLE, 24
.set CYDEV_ECC_ENABLE, 0
.set CYDEV_HEAP_SIZE, 0x80
.set CYDEV_INSTRUCT_CACHE_ENABLED, 1
.set CYDEV_INTR_RISING, 0x00008000
.set CYDEV_IS_EXPORTING_CODE, 0
.set CYDEV_IS_IMPORTING_CODE, 0
.set CYDEV_PROJ_TYPE, 0
.set CYDEV_PROJ_TYPE_BOOTLOADER, 1
.set CYDEV_PROJ_TYPE_LAUNCHER, 5
.set CYDEV_PROJ_TYPE_LOADABLE, 2
.set CYDEV_PROJ_TYPE_LOADABLEANDBOOTLOADER, 4
.set CYDEV_PROJ_TYPE_MULTIAPPBOOTLOADER, 3
.set CYDEV_PROJ_TYPE_STANDARD, 0
.set CYDEV_PROTECTION_ENABLE, 0
.set CYDEV_STACK_SIZE, 0x0800
.set CYDEV_USE_BUNDLED_CMSIS, 1
.set CYDEV_VARIABLE_VDDA, 0
.set CYDEV_VDDA_MV, 5000
.set CYDEV_VDDD_MV, 5000
.set CYDEV_VDDIO0_MV, 5000
.set CYDEV_VDDIO1_MV, 5000
.set CYDEV_VDDIO2_MV, 5000
.set CYDEV_VDDIO3_MV, 5000
.set CYDEV_VIO0_MV, 5000
.set CYDEV_VIO1_MV, 5000
.set CYDEV_VIO2_MV, 5000
.set CYDEV_VIO3_MV, 5000
.set CYIPBLOCK_ARM_CM3_VERSION, 0
.set CYIPBLOCK_P3_ANAIF_VERSION, 0
.set CYIPBLOCK_P3_CAN_VERSION, 0
.set CYIPBLOCK_P3_CAPSENSE_VERSION, 0
.set CYIPBLOCK_P3_COMP_VERSION, 0
.set CYIPBLOCK_P3_DECIMATOR_VERSION, 0
.set CYIPBLOCK_P3_DFB_VERSION, 0
.set CYIPBLOCK_P3_DMA_VERSION, 0
.set CYIPBLOCK_P3_DRQ_VERSION, 0
.set CYIPBLOCK_P3_DSM_VERSION, 0
.set CYIPBLOCK_P3_EMIF_VERSION, 0
.set CYIPBLOCK_P3_I2C_VERSION, 0
.set CYIPBLOCK_P3_LCD_VERSION, 0
.set CYIPBLOCK_P3_LPF_VERSION, 0
.set CYIPBLOCK_P3_OPAMP_VERSION, 0
.set CYIPBLOCK_P3_PM_VERSION, 0
.set CYIPBLOCK_P3_SCCT_VERSION, 0
.set CYIPBLOCK_P3_TIMER_VERSION, 0
.set CYIPBLOCK_P3_USB_VERSION, 0
.set CYIPBLOCK_P3_VIDAC_VERSION, 0
.set CYIPBLOCK_P3_VREF_VERSION, 0
.set CYIPBLOCK_S8_GPIO_VERSION, 0
.set CYIPBLOCK_S8_IRQ_VERSION, 0
.set CYIPBLOCK_S8_SAR_VERSION, 0
.set CYIPBLOCK_S8_SIO_VERSION, 0
.set CYIPBLOCK_S8_UDB_VERSION, 0
.set DMA_CHANNELS_USED__MASK0, 0x00000000
.set CYDEV_BOOTLOADER_ENABLE, 0
.endif
